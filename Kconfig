## Kconfig
```kconfig
# Copyright (c) 2024 The ZMK Contributors
# SPDX-License-Identifier: MIT

menu "Corne Daemon Notifier"

config ZMK_CORNE_DAEMON_NOTIFIER
    bool "Enable Corne daemon notifier"
    depends on !ZMK_SPLIT || ZMK_SPLIT_ROLE_CENTRAL
    default y if !ZMK_SPLIT || ZMK_SPLIT_ROLE_CENTRAL
    select RAW_HID
    help
      Sends active layer index and name to host daemon over Raw HID.
      On split keyboards, this feature is enabled only on the central half.

endmenu
```

## config/west.yml
```yaml
manifest:
  remotes:
    - name: zmkfirmware
      url-base: https://github.com/zmkfirmware
    - name: zzeneg
      url-base: https://github.com/zzeneg
      # Additional modules containing boards/shields/custom code can be listed here as well.
      # See:
      # - https://zmk.dev/docs/features/modules
      # - https://docs.zephyrproject.org/3.5.0/develop/west/manifest.html#projects
  projects:
    - name: zmk
      remote: zmkfirmware
      revision: v0.3.0
      import: app/west.yml
    - name: zmk-raw-hid
      remote: zzeneg
      revision: main
  self:
    path: config
```
